## application/edge_agent/boards/community/esp32_C3_4MB/sdkconfig.defaults.board
```kconfig
CONFIG_ESP_DEFAULT_CPU_FREQ_MHZ_160=y
CONFIG_ESPTOOLPY_FLASHMODE_DIO=y
CONFIG_ESPTOOLPY_FLASHFREQ_40M=y
CONFIG_ESPTOOLPY_FLASHSIZE_4MB=y
CONFIG_PARTITION_TABLE_CUSTOM=y
CONFIG_PARTITION_TABLE_CUSTOM_FILENAME="partitions_4MB.csv"
CONFIG_BT_ENABLED=n
CONFIG_HTTPD_WS_SUPPORT=n
CONFIG_FATFS_PER_FILE_CACHE=n
CONFIG_MBEDTLS_INTERNAL_MEM_ALLOC=y
CONFIG_MBEDTLS_DYNAMIC_BUFFER=y
CONFIG_MBEDTLS_DYNAMIC_FREE_CONFIG_DATA=y
CONFIG_MBEDTLS_DYNAMIC_FREE_CA_CERT=y
# C3 没有 PSRAM：TLS 接收缓冲默认 16 KB，叠加请求体、系统提示和工具清单后，
# 握手阶段会出现 mbedtls "alloc(...) failed"。实测 8 KB 能收下当前服务商的
# 证书链，再降到 4 KB 会握不上（证书链塞不下），所以 8 KB 是这里的安全下限。
CONFIG_MBEDTLS_SSL_IN_CONTENT_LEN=8192
# 发送记录默认 4 KB，对应 mbedtls 每条约 4.4 KB 的临时缓冲；C3 在握手后
# 写请求时常卡在这个尺寸上（alloc(4437) failed）。降到 2 KB 后请求体分多条
# 记录发出，对端无感，峰值省下约 2 KB。
CONFIG_MBEDTLS_SSL_OUT_CONTENT_LEN=2048
CONFIG_ESP_CONSOLE_SECONDARY_USB_SERIAL_JTAG=y

CONFIG_APP_CLAW_TEXT_ONLY=y
CONFIG_APP_CLAW_MEMORY_MODE_LIGHTWEIGHT=y
CONFIG_APP_CLAW_SYSTEM_UI_ENABLE=n
CONFIG_APP_CLAW_ENABLE_CLI=n
CONFIG_APP_CLAW_CAP_IM_QQ=y
CONFIG_APP_CLAW_CAP_IM_LOCAL=n
CONFIG_APP_CLAW_CAP_IM_TG=y
CONFIG_APP_CLAW_CAP_IM_FEISHU=y
CONFIG_APP_CLAW_CAP_IM_WECHAT=y
CONFIG_APP_CLAW_CAP_FILES=n
CONFIG_APP_CLAW_CAP_SCHEDULER=n
CONFIG_APP_CLAW_CAP_LUA=n
CONFIG_APP_CLAW_CAP_MICROPYTHON=n
CONFIG_APP_CLAW_CAP_MCP_CLIENT=n
CONFIG_APP_CLAW_CAP_MCP_SERVER=n
CONFIG_APP_CLAW_CAP_SKILL_MGR=n
CONFIG_APP_CLAW_CAP_LLM_INSPECT=n
CONFIG_APP_CLAW_CAP_HTTP_REQUEST=n
CONFIG_APP_CLAW_CAP_WEB_SEARCH=y
CONFIG_APP_CLAW_CAP_ROUTER_MGR=n
CONFIG_APP_CLAW_CAP_AGENT_MGR=n
```
